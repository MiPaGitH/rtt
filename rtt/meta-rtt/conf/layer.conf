## rtt/meta-rtt/conf/layer.conf
```bitbake
# We have a conf and classes directory, add to BBPATH
BBPATH .= ":${LAYERDIR}"

# We have recipes-* directories, add to BBFILES
BBFILES += "${LAYERDIR}/recipes-*/*/*.bb"

BBFILE_COLLECTIONS += "rtt"
BBFILE_PATTERN_rtt = "^${LAYERDIR}/"
BBFILE_PRIORITY_rtt = "6"
```
